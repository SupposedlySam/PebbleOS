## src/bluetooth-fw/Kconfig
```kconfig
# SPDX-FileCopyrightText: 2026 Core Devices LLC
# SPDX-License-Identifier: Apache-2.0

menu "Bluetooth"

choice BT_FW
    prompt "Bluetooth backend"
    default BT_FW_STUB
    help
      Which Bluetooth backend implementation to build. The default is
      derived from the SoC (see each src/fw/soc/<soc>/Kconfig.defconfig);
      the stub is the fallback when no SoC default applies.

config BT_FW_NIMBLE
    bool "NimBLE"
    select HAL_SIFLI_IPC_QUEUE if SOC_SF32LB52
    select HAL_SIFLI_LCPU if SOC_SF32LB52

config BT_FW_QEMU
    bool "QEMU transport"

config BT_FW_STUB
    bool "Stub (no backend)"

endchoice

module = BT
module-str = Bluetooth
source "src/fw/Kconfig.template.log_level"

config GH3X2X_TUNING_SERVICE_ENABLED
    bool "GH3X2X tuning service"
    depends on HRM_GH3X2X
    help
      Build the GH3X2X heart-rate sensor tuning GATT service, used to
      tune the sensor over BLE. Off by default.

config BT_DEV_NO_BOND
    bool "Dev: connect without BLE bonding (no pairing ceremony)"
    default n
    help
      DEVELOPMENT ONLY. Do not store BLE bonds, and start the PPoGATT / kernel
      LE client on a plain (unencrypted) connection instead of waiting for a
      bonding-add event. This removes the macOS pairing prompt and the
      bonded-reconnect gremlin in the phone-free Mac-gateway dev loop -- it
      relies on the Mac hosting the PPoG characteristics WITHOUT requiring
      encryption (PEBBLE_NO_ENCRYPT). Never enable in a shipping build.

endmenu
```
